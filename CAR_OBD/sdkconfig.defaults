## CAR_OBD/sdkconfig.defaults
```kconfig
# Board definition assumes 4 MB. Confirm fitted flash before uploading.
CONFIG_ESPTOOLPY_FLASHSIZE_4MB=y
CONFIG_ESPTOOLPY_FLASHSIZE="4MB"
CONFIG_LOG_DEFAULT_LEVEL_INFO=y
CONFIG_SPI_FLASH_SUPPORT_BOYA_CHIP=y
CONFIG_PARTITION_TABLE_CUSTOM=y
CONFIG_PARTITION_TABLE_CUSTOM_FILENAME="partitions.csv"
CONFIG_BT_ENABLED=y
CONFIG_BT_BLUEDROID_ENABLED=y
CONFIG_BTDM_CTRL_MODE_BR_EDR_ONLY=y
CONFIG_BT_CLASSIC_ENABLED=y
CONFIG_BT_SPP_ENABLED=y
CONFIG_BT_BLE_ENABLED=n
CONFIG_BTDM_CTRL_BR_EDR_MAX_ACL_CONN=1
CONFIG_BTDM_CTRL_BR_EDR_MAX_SYNC_CONN=0
```
